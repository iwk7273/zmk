## app/dts/bindings/behaviors/zmk,behavior-sensor-rotate-bindings.yaml
```yaml
# Copyright (c) 2026 The ZMK Contributors
# SPDX-License-Identifier: MIT

description: Sensor rotate behavior with keymap-editable direction bindings

compatible: "zmk,behavior-sensor-rotate-bindings"

include: behavior-metadata.yaml

properties:
  label:
    type: string
    required: false
    deprecated: true
  "#sensor-binding-cells":
    type: int
    required: true
    const: 0
  tap-ms:
    type: int
    default: 5
```

## app/dts/bindings/behaviors/zmk,behavior-user-macro.yaml
```yaml
# Copyright (c) 2026 The ZMK Contributors
# SPDX-License-Identifier: MIT

description: Settings-backed user macro behavior

compatible: "zmk,behavior-user-macro"

include: zero_param.yaml

properties:
  slot:
    type: int
    required: true
    description: Zero-based runtime user macro slot
```

## app/dts/bindings/macros/zmk,user-macro-default.yaml
```yaml
# Copyright (c) 2026 The ZMK Contributors
# SPDX-License-Identifier: MIT

description: Compile-time default body for a settings-backed user macro slot

compatible: "zmk,user-macro-default"

properties:
  slot:
    type: int
    required: true
    description: Zero-based user macro slot to seed when no saved value exists
  macro-name:
    type: string
    description: Display name for the seeded macro. Defaults to the node name.
  text:
    type: string
    required: true
    description: Packed ASCII text typed by the macro before any Studio edits
```
